## conf/layer.conf
```bitbake
# We have a conf and classes directory, add to BBPATH
BBPATH .= ":${LAYERDIR}"

# We have a recipes directory, add to BBFILES
BBFILES += "${LAYERDIR}/recipes-*/*/*.bb \
	    ${LAYERDIR}/recipes-*/*/*.bbappend"

BBFILE_COLLECTIONS += "alext-galileo"
BBFILE_PATTERN_alext-galileo := "^${LAYERDIR}/"
BBFILE_PRIORITY_alext-galileo = "9"
```
